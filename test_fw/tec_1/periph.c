#include "periph.h"
#include "hw.h"

void usart_tx_b(uint8_t data)
{
while (!(UCSR0A & _BV(UDRE0)));
UDR0 = data;
} 

void usart_tx_s(uint8_t * data)
{
while (*data!=0) 
  usart_tx_b(*data++);
} 


uint8_t usart_rx_rdy(void)
{
if (UCSR0A & _BV(RXC0))
  return 1;
else
  return 0;
}

uint8_t usart_rx_b(void)
{
return (uint8_t) UDR0;
} 

const char font5x7[455] =
   {0x00, 0x00, 0x00, 0x00, 0x00 ,  // sp
    0x00, 0x00, 0x2f, 0x00, 0x00 ,  // !
    0x00, 0x07, 0x00, 0x07, 0x00 ,  // "
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    0x44, 0x64, 0x54, 0x4C, 0x44};  // z 


#define  SSD1306_EXTERNALVCC 2

void disp_init (void)
{
unsigned char vccstate;
vccstate = 0;
DISP_PORT &= ~(1<<DISP_RST);
_delay_ms(1);
DISP_PORT |= (1<<DISP_RST);
_delay_ms(2);


disp_cmd(0xae);//--turn off oled panel
disp_cmd(0x00);//---set low column address
disp_cmd(0x10);//---set high column address
disp_cmd(0x40);//--set start line address
disp_cmd(0x81);//--set contrast control register
disp_cmd(0xcf);
disp_cmd(0xa1);//--set x mapping (a0/a1)
disp_cmd(0xc8);//--set y mapping (c0/c8)
disp_cmd(0xa6);//--set normal display
disp_cmd(0xa8);//--set multiplex ratio(1 to 64)
disp_cmd(0x3f);//--1/64 duty
disp_cmd(0xd3);//-set display offset
disp_cmd(0x00);//-not offset

disp_cmd(0xd5);//--set display clock divide ratio/oscillator frequency
disp_cmd(0x80);//--set divide ratio
disp_cmd(0xd9);//--set pre-charge period
disp_cmd(0xf1);
disp_cmd(0xda);//--set com pins hardware configuration
disp_cmd(0x12);
disp_cmd(0xdb);//--set vcomh
disp_cmd(0x40);
disp_cmd(0x8d);//--set Charge Pump enable/disable
disp_cmd(0x14);//--set(0x10) disable
disp_cmd(0xaf);//--turn on oled panel 

}


void i2c_init(void)
{
    TWSR = 0;                         //bez delicky
    TWBR = ((F_CPU/SCL_CLOCK)-16)/2;  //hodnota TWBR musi byt viac ako 10 t.j. FCPU > 3.6 MHz
}

/****************************************************
    start podmienka
    - smer prenosu
    - na zbernicu zapise adresu zariadenia
    - vrati 0 - po bezchybnom priebehu
    - vrati 1 - neuspesny start
    - vrati 2 - adresa nepotvrdena ACk bitom
****************************************************/

unsigned char i2c_start(unsigned char address, unsigned char dir)
{
	// posle start podmienku
	TWCR = (1<<TWINT) | (1<<TWSTA) | (1<<TWEN);

	// caka na jej prijatie
	while(!(TWCR & (1<<TWINT)));

	// kontrola TWSR
	if (((TWSR & 0xF8) != TW_START) && ((TWSR & 0xF8) != TW_REP_START)) return 1;

	// odosle adresu zariadenia s urcenim smeru prenosu dat
	TWDR = address | dir;
	TWCR = (1<<TWINT) | (1<<TWEN);

	// caka na dokoncenie presnosu
	while(!(TWCR & (1<<TWINT)));

	// kontrola TWSR
	if (((TWSR & 0xF8) != TW_MT_SLA_ACK) && ((TWSR & 0xF8) != TW_MR_SLA_ACK)) return 2;

	return 0;
}

/****************************************************
    opakovana start podmienka
****************************************************/

unsigned char i2c_rep_start(unsigned char address, unsigned char dir)
{
	return (i2c_start(address,dir));
}

/****************************************************
    stop podmienka
    - vrati 0 - po bezchybnom priebehu
    - vrati 1 - po neuspesnom stop
****************************************************/

unsigned char i2c_stop(void)
{
    	//odosle stop podmienku
	TWCR = (1<<TWINT)|(1<<TWEN)|(1<<TWSTO);

	//pocka na jej dokoncenie
	while(!(TWCR & (1<<TWSTO)));

	if ((TWSR & 0xF8) != TW_SR_STOP) return 1;

	return 0;
}

/****************************************************
    vysielanie byte-u na zbernicu
    - vrati 0 - po uspesnom vysielani - potvrdene s ACK
    - vrati 1 - data nepotvrdene ACK bitom
****************************************************/

unsigned char i2c_write(unsigned char data)
{
	//odosle data na predtym adresovane zariadenie
	TWDR = data;
	TWCR = (1<<TWINT)|(1<<TWEN);

	//caka na dokoncenie odosielania
	while(!(TWCR & (1<<TWINT)));

	//skontroluje stav TWSR
	if((TWSR & 0xF8) != TW_MT_DATA_ACK) return 1; 
	return 0; 
}

/****************************************************
    prijem byte-u zo zbernice - nie je posledny
    - vrati prijaty bajt a nasleduje dalsi bajt
****************************************************/

unsigned char i2c_read_Ack(void)
{
	TWCR = (1<<TWINT) | (1<<TWEN) | (1<<TWEA);
	while(!(TWCR & (1<<TWINT)));

        return TWDR;
}

/****************************************************
    prijem byte-u zo zbernice - posledny bajt
    - vrati prijaty bajt a nasleduje stop bit
****************************************************/

unsigned char i2c_read_nAck(void)
{
	TWCR = (1<<TWINT) | (1<<TWEN);
	while(!(TWCR & (1<<TWINT)));

        return TWDR;
}

unsigned char ssd1306_command(unsigned char data)
{
i2c_start(0x78,I2C_WRITE);
i2c_write(0x00);  
i2c_write(data);  
i2c_stop(); 
}

unsigned char disp_data(unsigned char data)
{
i2c_start(0x78,I2C_WRITE);
i2c_write(0x40);  
i2c_write(data);  
i2c_stop(); 
}

void putslcd(char *data)
{
unsigned int counter;
	counter=0;
		while(counter<21)
  			{  
		  	char_print(*data);
			*data++;
			counter++;
		  	}
}

void char_print (unsigned char data)
{
unsigned char underline;
unsigned int	disp_loop_var;
unsigned int temp;
i2c_start(0x78,I2C_WRITE);
iic_write(0x40);
if (data&0x80) underline = 1;
	else underline = 0;
data = data&0x7F;
if (data<' ') data = ' ';
temp = ((unsigned int)(data - 0x20)*5);
for (disp_loop_var=0;disp_loop_var<5;disp_loop_var++)
	{
	if (underline==1)	iic_write ((font5x7[temp+disp_loop_var])^0xFF) ;	
	else 				iic_write(font5x7[temp+disp_loop_var]);	
	}
if (underline==1)
	iic_write(0xFF);	
else
	iic_write(0x00);	
iic_stop();

}


void disp_set_xy (unsigned char x, unsigned char y)
{
if (y>7) return;
if (x>127) return;
lcd_cmd (0xB0+y);
lcd_cmd (0x00 + (x&0x0F));
lcd_cmd (0x10 + ((x>>4)&0x0F));
}

void clrscr (unsigned char data)
{
unsigned char x,y;
for (y=0;y<8;y++)
	{
	disp_set_xy(0,y);
        i2c_start(0x78,I2C_WRITE);
	iic_write(0x40);
	for (x=0;x<128;x++)
		iic_write(data);
	iic_stop();
	}
}

